## main/Kconfig.projbuild
```kconfig
menu "Multicast Replayer (P4)"

    choice MCR_ETH_PHY
        prompt "Ethernet PHY model"
        default MCR_ETH_PHY_IP101
        help
            RMII PHY chip wired to the ESP32-P4 EMAC.

        config MCR_ETH_PHY_IP101
            bool "IP101"
        config MCR_ETH_PHY_LAN87XX
            bool "LAN87xx"
        config MCR_ETH_PHY_RTL8201
            bool "RTL8201"
        config MCR_ETH_PHY_DP83848
            bool "DP83848"
        config MCR_ETH_PHY_KSZ80XX
            bool "KSZ80xx"
    endchoice

    config MCR_ETH_PHY_ADDR
        int "PHY address (-1 = autodetect)"
        range -1 31
        default -1

    config MCR_ETH_PHY_RST_GPIO
        int "PHY reset GPIO (-1 = not connected)"
        default -1

    config MCR_SD_PIN_CMD
        int "SD CMD GPIO"
        default 44

    config MCR_SD_PIN_CLK
        int "SD CLK GPIO"
        default 43

    config MCR_SD_PIN_D0
        int "SD D0 GPIO"
        default 39

    config MCR_SD_BUS_WIDTH_4
        bool "SD 4-bit bus"
        default y

    config MCR_SD_PIN_D1
        int "SD D1 GPIO"
        depends on MCR_SD_BUS_WIDTH_4
        default 40

    config MCR_SD_PIN_D2
        int "SD D2 GPIO"
        depends on MCR_SD_BUS_WIDTH_4
        default 41

    config MCR_SD_PIN_D3
        int "SD D3 GPIO"
        depends on MCR_SD_BUS_WIDTH_4
        default 42

    config MCR_SD_LDO_CHAN
        int "SD power LDO channel (-1 = external power)"
        default 4
        help
            On the ESP32-P4-Function-EV-Board the SD slot is powered from
            the on-chip LDO channel 4. Set -1 if the slot is powered
            externally.

endmenu
```

## sdkconfig.defaults
```kconfig
# ESP32-P4 multicast replayer (Ethernet)
CONFIG_IDF_TARGET="esp32p4"

CONFIG_ESPTOOLPY_FLASHSIZE_8MB=y

CONFIG_PARTITION_TABLE_CUSTOM=y
CONFIG_PARTITION_TABLE_CUSTOM_FILENAME="partitions.csv"

# 1ms tick for packet pacing
CONFIG_FREERTOS_HZ=1000

CONFIG_COMPILER_OPTIMIZATION_PERF=y
CONFIG_ESP_MAIN_TASK_STACK_SIZE=8192

# PSRAM (most P4 modules: 16/32MB) — large mallocs (stream index) land here
CONFIG_SPIRAM=y
CONFIG_SPIRAM_SPEED_200M=y
CONFIG_SPIRAM_USE_MALLOC=y
CONFIG_SPIRAM_MALLOC_ALWAYSINTERNAL=4096

# Internal EMAC + RMII PHY
CONFIG_ETH_USE_ESP32_EMAC=y

# FAT long filenames for SD card paths
CONFIG_FATFS_LFN_HEAP=y

# Console REPL
CONFIG_ESP_CONSOLE_USB_SERIAL_JTAG=y
```
